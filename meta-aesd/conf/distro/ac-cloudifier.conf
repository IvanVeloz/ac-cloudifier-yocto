## meta-aesd/conf/distro/ac-cloudifier.conf
```bitbake
### DISTRO OVERRIDES ###

DISTRO = "ac-cloudifier"

INIT_MANAGER = "systemd"

DISTRO_FEATURES:append = " systemd"
DISTRO_FEATURES:append = " wifi"
DISTRO_FEATURES_BACKFILL_CONSIDERED = "sysvinit"
VIRTUAL-RUNTIME_init_manager = "systemd"
VIRTUAL-RUNTIME_initscripts = ""

LICENSE_FLAGS_ACCEPTED += "synaptics-killswitch"
LICENSE_FLAGS_ACCEPTED += "commercial"

# add 500 megabytes at the end for development
IMAGE_ROOTFS_EXTRA_SPACE:append = " + 500000"
```

## meta-aesd/conf/machine/raspberrypi0-2w-64.conf
```bitbake
### SETTINGS FOR meta-raspberrypi BOARD SUPPORT PACKAGE ###
# Enable video camera
VIDEO_CAMERA = "1"
RASPBERRYPI_CAMERA_V3 = "1"


# Enable UART
# NOTE: this will affect performance 
# See https://meta-raspberrypi.readthedocs.io/en/latest/extra-build-config.html#enable-uart
ENABLE_UART = "1"

# Enable infrared
ENABLE_IR = "1"
GPIO_IR = "17"
GPIO_IR_TX = "18"

# Enable power button (works just like a PC)
ENABLE_GPIO_SHUTDOWN = "26"
```
